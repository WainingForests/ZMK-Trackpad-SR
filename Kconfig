## boards/shields/backup/skreepad/Kconfig.shield
```kconfig
config SHIELD_SKREEPAD_LEFT
    def_bool $(shields_list_contains,skreepad_left)

config SHIELD_SKREEPAD_RIGHT
    def_bool $(shields_list_contains,skreepad_right)
```

## boards/shields/screen_test/Kconfig.defconfig
```kconfig
if SHIELD_SCREEN_TEST

config ZMK_KEYBOARD_NAME
    default "Screen Test"

config SPI
    default y

config I2C
    default y

config ZMK_DISPLAY
    select LV_USE_LABEL

config ZMK_RGB_UNDERGLOW_EXT_POWER
    default n

config ZMK_KSCAN_MATRIX_WAIT_BEFORE_INPUTS
    default 0

config ZMK_KSCAN_MATRIX_WAIT_BETWEEN_OUTPUTS
    default 1

endif
```

## boards/shields/screen_test_c/Kconfig.defconfig
```kconfig
if SHIELD_SCREEN_TEST_C

config ZMK_KEYBOARD_NAME
    default "Screen Test C"

config SPI
    default y

config I2C
    default y

config ZMK_DISPLAY
    select LV_USE_LABEL

config ZMK_KSCAN_MATRIX_WAIT_BEFORE_INPUTS
    default 0

config ZMK_KSCAN_MATRIX_WAIT_BETWEEN_OUTPUTS
    default 1

endif
```

## boards/shields/skreepad/Kconfig.defconfig
```kconfig
if SHIELD_SKREEPAD_RIGHT

config ZMK_KEYBOARD_NAME
    default "Skreepad"

config ZMK_SPLIT_ROLE_CENTRAL
    default y

config ZMK_DISPLAY
    select LV_USE_LABEL

endif

if SHIELD_SKREEPAD_LEFT || SHIELD_SKREEPAD_RIGHT

config ZMK_SPLIT
    default y

config ZMK_SLEEP
    default y

config ZMK_POINTING
    default y

config SPI
    default y

config I2C
    default y

config INPUT
    default y

config ZMK_MOUSE
    default y

config INPUT_AZOTEQ_IQS5XX
    default y

config ZMK_RGB_UNDERGLOW_EXT_POWER
    default n

config ZMK_KSCAN_MATRIX_WAIT_BEFORE_INPUTS
    default 0

config ZMK_KSCAN_MATRIX_WAIT_BETWEEN_OUTPUTS
    default 1

endif

config ZMK_RGB_UNDERGLOW
    default y
    imply WS2812_STRIP
```
